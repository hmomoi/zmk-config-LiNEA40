## config/boards/shields/LiNEA40/Kconfig.defconfig
```kconfig
if SHIELD_LiNEA40_RIGHT
    config ZMK_KEYBOARD_NAME
        default "LiNEA40"
    config ZMK_SPLIT_ROLE_CENTRAL
        default y
    config MIPI_DBI
        bool
endif

if SHIELD_LiNEA40_LEFT || SHIELD_LiNEA40_RIGHT
    config ZMK_SPLIT
        default y
endif
```
